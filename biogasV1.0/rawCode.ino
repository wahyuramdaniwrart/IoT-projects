#include <Ewma.h>
#include <EwmaT.h>
#include <Wire.h>
#include <WiFi.h>
#include <PubSubClient.h>
#include <Adafruit_ADS1X15.h>
#include <DallasTemperature.h>
#include <OneWire.h>
#include <Adafruit_GFX.h>
#include <Fonts/FreeSans9pt7b.h>
#include <Adafruit_SSD1306.h>
#include <DHT.h>
#include <RTClib.h>
#include <SPI.h>
#include <SD.h>
#include "MQUnifiedsensor.h"

#define WIFI_SSID "BABY POCO"
#define WIFI_PASSWORD "ramdaniwahyu"
#define MQTT_BROKER "mqtt.eclipseprojects.io"
#define MQTT_PORT 1883

WiFiClient espClient;
PubSubClient client(espClient);

// Konfigurasi ADS1115
Adafruit_ADS1115 ads1;
Adafruit_ADS1115 ads2;

// Konfigurasi DS18B20
#define ONE_WIRE_BUS 26
OneWire oneWire(ONE_WIRE_BUS);
DallasTemperature ds18b20(&oneWire);
float suhu[3];

// Konfigurasi MPX5700AP
#define TC_PIN1 32
#define TC_PIN2 34
#define TC_PIN3 35
#define DIVIDER_RATIO 1.45

Ewma adcFilter1(0.1);
Ewma adcFilter2(0.1);
Ewma adcFilter3(0.1);
float tekanan1, tekanan2, tekanan3;
float MQ4_1, MQ4_2, MQ4_3, MQ135_1, MQ135_2, MQ135_3;

// Konfigurasi DHT11
#define DHT_PIN 14
DHT dht(DHT_PIN, DHT11);
float suhu_dht, kelembaban;

// Konfigurasi OLED
#define SCREEN_WIDTH 128
#define SCREEN_HEIGHT 64
#define OLED_RESET -1
Adafruit_SSD1306 display(SCREEN_WIDTH, SCREEN_HEIGHT, &Wire, OLED_RESET);

// Variabel Status
bool wifiStatus = false;
bool rekamData = false;
bool kirimData = false;

// Konfigurasi SD Card
#define SD_CS 5

// Timer
unsigned long previousMillis = 0;
const long interval = 5000; // Interval pembaruan tampilan (5 detik)
int sensorIndex = 0;

// Bitmap untuk indikator status
static const unsigned char PROGMEM wifi [] = {
  0x00, 0x00, 0x00, 0x00, 0x00, 0x00, 0x00, 0x07, 0x00, 0x00, 0x07, 0x00, 0x00, 0x07, 0x00, 0x00, 
	0x07, 0x00, 0x00, 0x07, 0x00, 0x00, 0x37, 0x00, 0x00, 0x37, 0x00, 0x00, 0x37, 0x00, 0x00, 0x37, 
	0x00, 0x03, 0x37, 0x00, 0x03, 0x37, 0x00, 0x33, 0x37, 0x00, 0x3b, 0x37, 0x00, 0x3b, 0x37, 0x00, 
	0x00, 0x00, 0x00, 0x00, 0x00, 0x00
};

const unsigned char nowifi [] PROGMEM = {
	// 'Aniket-Suvarna-Box-Regular-Bx-no-signal, 18x18px
	0x00, 0x00, 0x00, 0x00, 0x00, 0x00, 0x30, 0x03, 0x00, 0x38, 0x03, 0x00, 0x1c, 0x03, 0x00, 0x0e, 
	0x1b, 0x00, 0x07, 0x1b, 0x00, 0x03, 0xdb, 0x00, 0x01, 0xdb, 0x00, 0x00, 0xfb, 0x00, 0x06, 0x7b, 
	0x00, 0x06, 0x3b, 0x00, 0x36, 0x9f, 0x00, 0x36, 0xcf, 0x00, 0x36, 0xc7, 0x00, 0x36, 0xd3, 0x00, 
	0x00, 0x00, 0x00, 0x00, 0x00, 0x00
};

const unsigned char sdcard [] PROGMEM = {
	// 'Pictogrammers-Material-Micro-sd, 18x18px
	0x00, 0x00, 0x00, 0x00, 0x00, 0x00, 0x07, 0xfe, 0x00, 0x0e, 0x86, 0x00, 0x0e, 0x86, 0x00, 0x0e, 
	0x86, 0x00, 0x0f, 0xfe, 0x00, 0x0f, 0xfe, 0x00, 0x0f, 0xfe, 0x00, 0x1f, 0xfe, 0x00, 0x1f, 0xfe, 
	0x00, 0x1f, 0xfe, 0x00, 0x1f, 0xfe, 0x00, 0x1f, 0xfe, 0x00, 0x1f, 0xfe, 0x00, 0x1f, 0xfe, 0x00, 
	0x00, 0x00, 0x00, 0x00, 0x00, 0x00
};

const unsigned char nosdcard [] PROGMEM = {
	// 'Pictogrammers-Material-Micro-sd, 18x18px
	0x00, 0x00, 0x00, 0x00, 0x00, 0x00, 0x07, 0xfc, 0x00, 0x06, 0x80, 0x00, 0x02, 0x80, 0x00, 0x00, 
	0x80, 0x00, 0x00, 0xc2, 0x00, 0x00, 0x06, 0x00, 0x0c, 0x0e, 0x00, 0x1e, 0x1e, 0x00, 0x1c, 0x0e, 
	0x00, 0x18, 0x06, 0x00, 0x10, 0xc0, 0x00, 0x01, 0xe0, 0x00, 0x03, 0xf0, 0x00, 0x07, 0xf8, 0x00, 
	0x00, 0x00, 0x00, 0x00, 0x00, 0x00
};

const unsigned char pesan [] PROGMEM = {
	// 'Iconka-Business-Outline-Message, 18x18px
	0x00, 0x00, 0x00, 0x00, 0x00, 0x00, 0x3f, 0xff, 0x00, 0x3f, 0xff, 0x00, 0x3f, 0xff, 0x00, 0x3f, 
	0x3f, 0x00, 0x3f, 0x9f, 0x00, 0x3c, 0x0f, 0x00, 0x3f, 0x9f, 0x00, 0x3f, 0x3f, 0x00, 0x3f, 0xff, 
	0x00, 0x3f, 0xff, 0x00, 0x3f, 0xff, 0x00, 0x3f, 0xfe, 0x00, 0x30, 0x00, 0x00, 0x20, 0x00, 0x00, 
	0x00, 0x00, 0x00, 0x00, 0x00, 0x00
};

const unsigned char nopesan [] PROGMEM = {
	// 'Pictogrammers-Material-Message-bulleted-off, 18x18px
	0x00, 0x00, 0x00, 0x00, 0x00, 0x00, 0xcf, 0xff, 0x00, 0x67, 0xff, 0x00, 0x33, 0xff, 0x00, 0x38, 
	0x07, 0x00, 0x3c, 0xff, 0x00, 0x3e, 0x07, 0x00, 0x3f, 0x3f, 0x00, 0x3b, 0x9f, 0x00, 0x3b, 0xcf, 
	0x00, 0x3f, 0xe7, 0x00, 0x3f, 0xf3, 0x00, 0x3f, 0xf8, 0x00, 0x30, 0x0c, 0x00, 0x20, 0x06, 0x00, 
	0x00, 0x03, 0x00, 0x00, 0x01, 0x00
};

const unsigned char wrart [] PROGMEM = {
	// 'wrart-logo, 128x64px
	0x00, 0x00, 0x00, 0x00, 0x00, 0x00, 0x00, 0x00, 0x00, 0x00, 0x00, 0x00, 0x00, 0x00, 0x00, 0x00, 
	0x00, 0x00, 0x00, 0x00, 0x00, 0x00, 0x00, 0x00, 0x00, 0x00, 0x00, 0x00, 0x00, 0x00, 0x00, 0x00, 
	0x00, 0x00, 0x07, 0x00, 0x03, 0xac, 0x18, 0x5c, 0xcd, 0x00, 0xd0, 0x09, 0x05, 0xf0, 0x00, 0x00, 
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	0x00, 0x00, 0x00, 0x00, 0x00, 0x00, 0x00, 0x00, 0x00, 0x00, 0x00, 0x00, 0x00, 0x00, 0x00, 0x00
};

void setup() {
    Serial.begin(115200);

    // Inisialisasi WiFi
    WiFi.begin(WIFI_SSID, WIFI_PASSWORD);
    Serial.println("Connecting to WiFi...");
    wifiStatus = (WiFi.status() == WL_CONNECTED);

    // Inisialisasi MQTT
    client.setServer(MQTT_BROKER, MQTT_PORT);

    // Inisialisasi Sensor
    ads1.begin(0x48);
    ads2.begin(0x49);
    ds18b20.begin();
    dht.begin();

    // Inisialisasi SD Card
    if (!SD.begin(SD_CS)) {
        Serial.println("SD Card initialization failed!");
        rekamData = false;
    } else {
        rekamData = true;
    }

    // Inisialisasi OLED
    if (!display.begin(SSD1306_SWITCHCAPVCC, 0x3C)) {
        Serial.println("SSD1306 initialization failed!");
    }
    display.clearDisplay();
    display.drawBitmap(0, 0, wrart, 128, 64, WHITE);
    display.display();
}

void loop() {
    unsigned long currentMillis = millis();

    // Periksa status WiFi secara berkala
    wifiStatus = (WiFi.status() == WL_CONNECTED);

    // Periksa status SD Card secara berkala
    rekamData = SD.begin(SD_CS);

    // Periksa status MQTT secara berkala
    if (!client.connected()) {
        reconnect();
    }
    client.loop();

    // Pembacaan sensor setiap 5 detik
    if (currentMillis - previousMillis >= interval) {
        previousMillis = currentMillis;

        // Baca semua sensor
        readSensors();

        // Tampilkan data di LCD
        displayData();

        // Kirim data ke MQTT
        mqtt();

        // Rekam data ke SD Card
        logData();

        // Ganti tampilan sensor
        sensorIndex = (sensorIndex + 1) % 5;
    }
}

void readSensors() {
    // Baca suhu DS18B20
    ds18b20.requestTemperatures();
    for (int i = 0; i < 3; i++) {
        suhu[i] = ds18b20.getTempCByIndex(i);
    }

    // Baca tekanan MPX5700AP
    tekanan1 = readMPX(TC_PIN1, adcFilter1);
    tekanan2 = readMPX(TC_PIN2, adcFilter2);
    tekanan3 = readMPX(TC_PIN3, adcFilter3);

    // Baca DHT11
    suhu_dht = dht.readTemperature();
    kelembaban = dht.readHumidity();

    // Baca MQ135 dan MQ4
    MQ135_1 = mq135Calb(readVoltage(ads1, 0));
    MQ135_2 = mq135Calb(readVoltage(ads1, 1));
    MQ135_3 = mq135Calb(readVoltage(ads1, 2));

    MQ4_1 = mq4Calb(readVoltage(ads2, 0));
    MQ4_2 = mq4Calb(readVoltage(ads2, 1));
    MQ4_3 = mq4Calb(readVoltage(ads2, 2));
}

void displayData() {
    display.clearDisplay();
    display.setTextSize(1);
    display.setTextColor(SSD1306_WHITE);
    display.setCursor(0, 7);
    display.println("BIO GAS");

    // Tampilkan status perangkat
    display.drawBitmap(70, 0, wifiStatus ? wifi : nowifi, 18, 18, WHITE);
    display.drawBitmap(90, 0, rekamData ? sdcard : nosdcard, 18, 18, WHITE);
    display.drawBitmap(110, 0, kirimData ? pesan : nopesan, 18, 18, WHITE);

    // Garis pemisah
    display.drawLine(0, 20, 128, 20, SSD1306_WHITE);

    // Tampilkan data sensor
    display.setTextSize(1);
    display.setCursor(0, 25);
    switch (sensorIndex) {
        case 0:
            display.println("MQ135 (ppm):");
            display.printf("1: %.2f\n", MQ135_1);
            display.printf("2: %.2f\n", MQ135_2);
            display.printf("3: %.2f\n", MQ135_3);
            break;
        case 1:
            display.println("MQ4 (ppm):");
            display.printf("1: %.2f\n", MQ4_1);
            display.printf("2: %.2f\n", MQ4_2);
            display.printf("3: %.2f\n", MQ4_3);
            break;
        case 2:
            display.println("Tekanan (kPa):");
            display.printf("1: %.2f\n", tekanan1);
            display.printf("2: %.2f\n", tekanan2);
            display.printf("3: %.2f\n", tekanan3);
            break;
        case 3:
            display.println("Suhu Bahan (C):");
            display.printf("1: %.2f\n", suhu[0]);
            display.printf("2: %.2f\n", suhu[1]);
            display.printf("3: %.2f\n", suhu[2]);
            break;
        case 4:
            display.println("DHT:");
            display.printf("Suhu: %.2f C\n", suhu_dht);
            display.printf("Kelembaban: %.2f%%\n", kelembaban);
            break;
    }

    display.display();
}

void mqtt() {
    if (!client.connected()) {
        reconnect();
    }

    char payload[20];
    snprintf(payload, sizeof(payload), "%.2f", MQ135_1);
    client.publish("sensor/mq135_1", payload);

    snprintf(payload, sizeof(payload), "%.2f", MQ135_2);
    client.publish("sensor/mq135_2", payload);
    
    snprintf(payload, sizeof(payload), "%.2f", MQ135_3);
    client.publish("sensor/mq135_3", payload);
    
    snprintf(payload, sizeof(payload), "%.2f", MQ4_1);
    client.publish("sensor/mq4_1", payload);
    
    snprintf(payload, sizeof(payload), "%.2f", MQ4_2);
    client.publish("sensor/mq4_2", payload);
    
    snprintf(payload, sizeof(payload), "%.2f", MQ4_3);
    client.publish("sensor/mq4_3", payload);
    
    snprintf(payload, sizeof(payload), "%.2f", tekanan1);
    client.publish("sensor/tekanan1", payload);
    
    snprintf(payload, sizeof(payload), "%.2f", tekanan2);
    client.publish("sensor/tekanan2", payload);
    
    snprintf(payload, sizeof(payload), "%.2f", tekanan3);
    client.publish("sensor/tekanan3", payload);
    
    snprintf(payload, sizeof(payload), "%.2f", suhu[0]);
    client.publish("sensor/temp1", payload);
    
    snprintf(payload, sizeof(payload), "%.2f", suhu[1]);
    client.publish("sensor/temp2", payload);
    
    snprintf(payload, sizeof(payload), "%.2f", suhu[2]);
    client.publish("sensor/temp3", payload);
    
    snprintf(payload, sizeof(payload), "%.2f", suhu_dht);
    client.publish("sensor/dht_temp", payload);
    
    snprintf(payload, sizeof(payload), "%.2f", kelembaban);
    client.publish("sensor/dht_hum", payload);

    kirimData = true;
}

void logData() {
    if (rekamData) {
        String data = String(millis()) + "," +
                      String(MQ135_1) + "," + String(MQ135_2) + "," + String(MQ135_3) + "," +
                      String(MQ4_1) + "," + String(MQ4_2) + "," + String(MQ4_3) + "," +
                      String(tekanan1) + "," + String(tekanan2) + "," + String(tekanan3) + "," +
                      String(suhu[0]) + "," + String(suhu[1]) + "," + String(suhu[2]) + "," +
                      String(suhu_dht) + "," + String(kelembaban);

        File file = SD.open("/data.csv", FILE_APPEND);
        if (file) {
            file.println(data);
            file.close();
        } else {
            rekamData = false; // SD Card error
        }
    }
}

void reconnect() {
    while (!client.connected()) {
        Serial.print("Connecting to MQTT...");
        if (client.connect("ESP32Client")) {
            Serial.println("Connected!");
            wifiStatus = true;
        } else {
            Serial.print("Failed, rc=");
            Serial.print(client.state());
            Serial.println(" Retrying in 5 seconds...");
            delay(5000);
        }
    }
}

float readMPX(int pin, Ewma &filter) {
    int raw = analogRead(pin) - 520;
    float filtered = filter.filter(raw);
    float V_adc = (filtered * 3.3) / 4095;
    float V_sensor = ((V_adc / (5.0 * DIVIDER_RATIO))) / 0.0012858;
    float calibrated_pressure = (2.3488 * V_sensor) - 0.6846;
    return calibrated_pressure < 0 ? 0 : calibrated_pressure;
}

float mq135Calb(float voltage) {
    return (3601.9 * voltage * voltage) - (1190.6 * voltage) + 461.63;
}

float mq4Calb(float voltage) {
    return (0.0021 * voltage * voltage) + (1.9768 * voltage) + 11.743;
}

float readVoltage(Adafruit_ADS1115 &ads, int channel) {
    int16_t adc = ads.readADC_SingleEnded(channel);
    return (adc * 0.1875) / 1000.0; // Konversi ke volt
}
